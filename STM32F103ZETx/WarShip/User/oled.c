#include "oled.h"
#include <stdarg.h>

static uint8_t OLED_Buffer[8][128];

const unsigned char OLED_ASCII_1206[95][12] = {
    {0x00, 0x00, 0x00, 0x00, 0x00, 0x00, 0x00, 0x00, 0x00, 0x00, 0x00, 0x00}, /*" ",0*/
    {0x00, 0x00, 0x00, 0x00, 0x3F, 0x40, 0x00, 0x00, 0x00, 0x00, 0x00, 0x00}, /*"!",1*/
    {0x00, 0x00, 0x30, 0x00, 0x40, 0x00, 0x30, 0x00, 0x40, 0x00, 0x00, 0x00}, /*""",2*/
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    {0x40, 0x00, 0x80, 0x00, 0x40, 0x00, 0x20, 0x00, 0x20, 0x00, 0x40, 0x00}, /*"~",94*/
};

const unsigned char OLED_ASCII_1608[95][16] = {
    {0x00, 0x00, 0x00, 0x00, 0x00, 0x00, 0x00, 0x00, 0x00, 0x00, 0x00, 0x00, 0x00, 0x00, 0x00, 0x00}, /*" ",0*/
    {0x00, 0x00, 0x00, 0x00, 0x00, 0x00, 0x1F, 0xCC, 0x00, 0x0C, 0x00, 0x00, 0x00, 0x00, 0x00, 0x00}, /*"!",1*/
    {0x00, 0x00, 0x08, 0x00, 0x30, 0x00, 0x60, 0x00, 0x08, 0x00, 0x30, 0x00, 0x60, 0x00, 0x00, 0x00}, /*""",2*/
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    {0x60, 0x00, 0x80, 0x00, 0x80, 0x00, 0x40, 0x00, 0x20, 0x00, 0x20, 0x00, 0xC0, 0x00, 0x00, 0x00}, /*"~",94*/
};

static void OLED_WriteGPIOPort(uint8_t data)
{
  uint16_t temp;

  temp = OLED_DATA_GPIO_Port->ODR & 0xFF00;
  OLED_DATA_GPIO_Port->ODR = temp | (uint16_t)data;
}

static void OLED_WriteData(uint8_t data)
{
  OLED_WriteGPIOPort(data);
  HAL_GPIO_WritePin(OLED_DC_GPIO_Port, OLED_DC_Pin, GPIO_PIN_SET);
  HAL_GPIO_WritePin(OLED_CS_GPIO_Port, OLED_CS_Pin, GPIO_PIN_RESET);
  HAL_GPIO_WritePin(OLED_WR_GPIO_Port, OLED_WR_Pin, GPIO_PIN_RESET);
  HAL_GPIO_WritePin(OLED_WR_GPIO_Port, OLED_WR_Pin, GPIO_PIN_SET);
  HAL_GPIO_WritePin(OLED_CS_GPIO_Port, OLED_CS_Pin, GPIO_PIN_SET);
  HAL_GPIO_WritePin(OLED_DC_GPIO_Port, OLED_DC_Pin, GPIO_PIN_SET);
}

// static uint8_t OLED_ReadDate(void)
// {
//   HAL_GPIO_WritePin(OLED_DC_GPIO_Port, OLED_DC_Pin, GPIO_PIN_SET);
//   HAL_GPIO_WritePin(OLED_CS_GPIO_Port, OLED_CS_Pin, GPIO_PIN_RESET);
//   HAL_GPIO_WritePin(OLED_RD_GPIO_Port, OLED_RD_Pin, GPIO_PIN_RESET);
//   HAL_GPIO_WritePin(OLED_RD_GPIO_Port, OLED_RD_Pin, GPIO_PIN_SET);
//   HAL_GPIO_WritePin(OLED_CS_GPIO_Port, OLED_CS_Pin, GPIO_PIN_SET);
//   HAL_GPIO_WritePin(OLED_DC_GPIO_Port, OLED_DC_Pin, GPIO_PIN_SET);

//   return (uint8_t)(OLED_DATA_GPIO_Port->IDR & 0x00FF);
// }

static void OLED_WriteCommand(uint8_t command)
{
  OLED_WriteGPIOPort(command);
  HAL_GPIO_WritePin(OLED_DC_GPIO_Port, OLED_DC_Pin, GPIO_PIN_RESET);
  HAL_GPIO_WritePin(OLED_CS_GPIO_Port, OLED_CS_Pin, GPIO_PIN_RESET);
  HAL_GPIO_WritePin(OLED_WR_GPIO_Port, OLED_WR_Pin, GPIO_PIN_RESET);
  HAL_GPIO_WritePin(OLED_WR_GPIO_Port, OLED_WR_Pin, GPIO_PIN_SET);
  HAL_GPIO_WritePin(OLED_CS_GPIO_Port, OLED_CS_Pin, GPIO_PIN_SET);
  HAL_GPIO_WritePin(OLED_DC_GPIO_Port, OLED_DC_Pin, GPIO_PIN_SET);
}

static void OLED_Reset(void)
{
  HAL_GPIO_WritePin(GPIOC, OLED_D0_Pin|OLED_D1_Pin|OLED_D2_Pin|OLED_D3_Pin 
                          |OLED_D4_Pin|OLED_D5_Pin|OLED_D6_Pin|OLED_D7_Pin, GPIO_PIN_SET);
  HAL_GPIO_WritePin(GPIOD, OLED_DC_Pin|OLED_CS_Pin, GPIO_PIN_SET);
  HAL_GPIO_WritePin(GPIOG, OLED_RD_Pin|OLED_WR_Pin|OLED_RST_Pin, GPIO_PIN_SET);
  
  HAL_GPIO_WritePin(OLED_RST_GPIO_Port, OLED_RST_Pin, GPIO_PIN_RESET);
  HAL_GPIO_WritePin(OLED_RST_GPIO_Port, OLED_RST_Pin, GPIO_PIN_SET);
}

void OLED_Init(void)
{
  OLED_Reset();

  OLED_WriteCommand(0xAE); //display off

  OLED_WriteCommand(0xD5); //Set Display Clock Divide
  OLED_WriteCommand(0x80); //[3:0]+1:Divide ratio;[7:4]:Oscillator Frequency

  OLED_WriteCommand(0xA8); //Set Multiplex Ratio
  OLED_WriteCommand(0x3F); //[5:0]+1:form 16 to 64

  OLED_WriteCommand(0xD3); //Set Display Offset
  OLED_WriteCommand(0x00); //[5:0]

  OLED_WriteCommand(0x40); //Set Display Start Line

  OLED_WriteCommand(0x8D); //Charge Pump Setting
  OLED_WriteCommand(0x14); //[3]:0:off;1:ON

  OLED_WriteCommand(0x20); //Set Memory Addressing Mode
  OLED_WriteCommand(0x02); //[1:0]:00:Horizontal;01:Vertical;10:Page(default)

  OLED_WriteCommand(0xA0); //Set Segment Re-map

  OLED_WriteCommand(0xC0); //Set COM Output Scan Direction

  OLED_WriteCommand(0xDA); //Set COM Pins Hardware Configuration
  OLED_WriteCommand(0x12); //

  OLED_WriteCommand(0x81); //Set Contrast Control
  OLED_WriteCommand(0xEF); //[7:0](default:0x7F)

  OLED_WriteCommand(0xD9); //Set Pre-charge Period
  OLED_WriteCommand(0xF1); //[3:0]:PHASE 1;[7:4]:PHASE 2

  OLED_WriteCommand(0xDB); //Set VCOMH Deselect Level
  OLED_WriteCommand(0x30); //[6:4]:0x00:0.65*vcc;0x20:0.77*vcc;0x30:0.83*vcc

  OLED_WriteCommand(0xA4); //0xA4:Resume to RAM content display;0xA5:Entire display ON Output ignores RAM content
  OLED_WriteCommand(0xA6); //Set Normal(0xA6)/Inverse(0xA7) Display

  OLED_WriteCommand(0xAF); //Set Display ON
}

void OLED_Refresh(uint8_t data)
{
  int i, j;

  for (i = 0; i < 8; i++)
  {
    //
    OLED_WriteCommand(0xB0 + i);
    OLED_WriteCommand(0x00);
    OLED_WriteCommand(0x10);
    for (j = 0; j < 128; j++)
    {
      OLED_Buffer[i][j] = data;
      // OLED_WriteData(OLED_Buffer[i][j]);
      OLED_WriteData(data);
    }
  }
}

void OLED_DrawPixel(uint8_t x, uint8_t y)
{
  uint8_t temp, row;

  if (x > 128 || y > 64)
    return;

  y = 63 - y;
  row = y / 8;
  temp = 0x01 << (y % 8);
  x = 127 - x;

  // OLED_WriteCommand(0xB0 | row);
  // OLED_WriteCommand(0x00 | (0x0F & x));
  // OLED_WriteCommand(0x10 | ((0xF0 & x) >> 4));
  // OLED_ReadDate();
  // temp |= OLED_ReadDate();
  OLED_WriteCommand(0xB0 | row);
  OLED_WriteCommand(0x00 | (0x0F & x));
  OLED_WriteCommand(0x10 | ((0xF0 & x) >> 4));
  OLED_Buffer[row][x] |= temp;
  OLED_WriteData(OLED_Buffer[row][x]);
}

void OLED_PrintChar(char ch, uint8_t x, uint8_t y, OLED_CharSizeTypeDef size)
{
  int i;

  if (ch < ' ')
    return;
  else
    ch -= ' ';

  if (size == OLED_CHAR_SIZE_1608)
  {
    if (x > 16 || y > 4)
      return;

    x = 15 - x;
    y = 3 - y;
    x *= 8;
    y *= 2;

    OLED_WriteCommand(0xB0 | y);
    OLED_WriteCommand(0x00 | (0x0F & x));
    OLED_WriteCommand(0x10 | ((0xF0 & x) >> 4));
    for (i = 7; i >= 0; i--)
    {
      OLED_Buffer[y][x + 7 - i] = OLED_ASCII_1608[ch][2 * i + 1];
      OLED_WriteData(OLED_Buffer[y][x + 7 - i]);
    }

    OLED_WriteCommand(0xB0 | (y + 1));
    OLED_WriteCommand(0x00 | (0x0F & x));
    OLED_WriteCommand(0x10 | ((0xF0 & x) >> 4));
    for (i = 7; i >= 0; i--)
    {
      OLED_Buffer[y + 1][x + 7 - i] = OLED_ASCII_1608[ch][2 * i];
      OLED_WriteData(OLED_Buffer[y + 1][x + 7 - i]);
    }
  }
  else
  {
    if (x > 21 || y > 4)
      return;

    x = 20 - x;
    y = 3 - y;
    x *= 6;
    y *= 2;

    OLED_WriteCommand(0xB0 | y);
    OLED_WriteCommand(0x00 | (0x0F & x));
    OLED_WriteCommand(0x10 | ((0xF0 & x) >> 4));
    for (i = 5; i >= 0; i--)
    {
      OLED_Buffer[y][x + 5 - i] = OLED_ASCII_1206[ch][2 * i + 1];
      OLED_WriteData(OLED_Buffer[y][x + 5 - i]);
    }

    OLED_WriteCommand(0xB0 | (y + 1));
    OLED_WriteCommand(0x00 | (0x0F & x));
    OLED_WriteCommand(0x10 | ((0xF0 & x) >> 4));
    for (i = 5; i >= 0; i--)
    {
      OLED_Buffer[y + 1][x + 5 - i] = OLED_ASCII_1206[ch][2 * i];
      OLED_WriteData(OLED_Buffer[y + 1][x + 5 - i]);
    }
  }
}

int OLED_printf(OLED_CharSizeTypeDef size, const char *format, ...)
{
  char s[128];
  int n;

  va_list list;
  va_start(list, format);

  n = vsprintf(s, format, list);

  for (int i = 0, j = 0; i < n; i++)
  {
    // i：the ptr of the string
    // j: the ptr of the screen
    if (size == OLED_CHAR_SIZE_1608)
    {
      if (s[i] == '\r')
      {
        j -= j % 16;
      }
      else if (s[i] == '\n')
      {
        j += 16;
      }
      else if (s[i] == '\b')
      {
        (j > 0)?(j--):(j = 0);
      }
      else
      {
        OLED_PrintChar(s[i], j % 16, j / 16, size);
        j++;
      }
    }
    else
    {
      if (s[i] == '\r')
      {
        j -= j % 21;
      }
      else if (s[i] == '\n')
      {
        j += 21;
      }
      else if (s[i] == '\b')
      {
        (j > 0)?(j--):(j = 0);
      }
      else
      {
        OLED_PrintChar(s[i], j % 21, j / 21, size);
        j++;
      }
    }
  }

  va_end(list);

  return n;
}
